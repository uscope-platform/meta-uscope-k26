## conf/layer.conf
```bitbake
# We have a conf and classes directory, add to BBPATH
BBPATH .= ":${LAYERDIR}"

# We have recipes-* directories, add to BBFILES
BBFILES += "${LAYERDIR}/recipes-*/*/*.bb \
            ${LAYERDIR}/recipes-*/*/*.bbappend"

BBFILE_COLLECTIONS += "meta-uscope"
BBFILE_PATTERN_meta-uscope = "^${LAYERDIR}/"
BBFILE_PRIORITY_meta-uscope = "6"

LAYERDEPENDS_meta-uscope = "core"
LAYERSERIES_COMPAT_meta-uscope = "warrior zeus honister langdale"
```
