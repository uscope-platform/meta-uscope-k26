/ {
    uScope@fffc0000 {
        compatible = "ucube_lkm";
        reg = <0xfffc0000 0x8000>;
        interrupts = <0 89 1>;
        interrupt-parent = <&gic>;
        ucubever = "zynqmp";
    };
    debug_bridge@a0000000 {
        compatible = "xlnx,xvc";
        reg = <0x0 0xa0000000 0x0 0x10000>;
        clocks = <&zynqmp_clk 71>;
        status = "okay";
        clock-names = "s_axi_aclk";
    };
};
